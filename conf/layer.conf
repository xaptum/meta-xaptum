## conf/layer.conf
```bitbake
BBPATH .= ":${LAYERDIR}"

BBFILES += "${LAYERDIR}/recipes-*/*/*.bb \
        ${LAYERDIR}/recipes-*/*/*.bbappend"

BBFILE_COLLECTIONS += "xaptum"
BBFILE_PATTERN_xaptum = "^${LAYERDIR}/"
BBFILE_PRIORITY_xaptum = "6"
```
